## .github/deps/local_defconfig
```kconfig
CONFIG_BPF_SYSCALL=y
CONFIG_SMP=y
CONFIG_MODULES=y
CONFIG_NET=y
CONFIG_TLS=y
CONFIG_TLS_DEVICE=y
CONFIG_INET=y
CONFIG_NET_SWITCHDEV=y
CONFIG_PCI=y
CONFIG_PCI_MSI=y
CONFIG_PCI_IOV=y
CONFIG_NETDEVICES=y
CONFIG_VXLAN=y
CONFIG_NFP=m
CONFIG_ISO9660_FS=y
CONFIG_ZISOFS=y
```
